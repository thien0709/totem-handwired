#include "totem_hw.dtsi"

&kscan_matrix {
    col-gpios
        = <&gpio1 13 GPIO_ACTIVE_HIGH>
        , <&gpio1 15 GPIO_ACTIVE_HIGH> 
        , <&gpio0 2  GPIO_ACTIVE_HIGH> 
        , <&gpio0 29 GPIO_ACTIVE_HIGH> 
        , <&gpio0 31 GPIO_ACTIVE_HIGH>
        ;
};

&kscan_direct {
    input-gpios = <&gpio1 11 (GPIO_ACTIVE_LOW | GPIO_PULL_UP)>;
};

&left_encoder {
    a-gpios = <&gpio1 0 (GPIO_ACTIVE_HIGH | GPIO_PULL_UP)>;
    b-gpios = <&gpio0 11 (GPIO_ACTIVE_HIGH | GPIO_PULL_UP)>;
    status = "okay";
};

&sensors {
    sensors = <&left_encoder>;
};